## drivers/input/touchscreen/oppo_touchscreen/Goodix/Goodix_gt5688/Kconfig
```kconfig
config TOUCHPANEL_GOODIX_GT5688
	default n
	bool "TP TOUCHPANEL_GOODIX_GT5688 IC enable or not for OPPO"
	---help---
	say Y to enable driver for Touchpanel useing TOUCHPANEL_GOODIX_GT5688
	
```

## drivers/input/touchscreen/oppo_touchscreen/Kconfig
```kconfig
config TOUCHPANEL_OPPO
	bool "OPPO tp module"
	help
	  Say Y here if you have touchscreen module.

config TOUCHPANEL_GOODIX
	default n
	bool "TP Synaptics_IC enable or not for OPPO"
	---help---
	say Y to enable driver for Touchpanel useing GOODIX_IC

source "drivers/input/touchscreen/oppo_touchscreen/Goodix/Kconfig"
```

## drivers/misc/ktd_shineled/Kconfig
```kconfig
config KTD2026_SLED
	tristate "KTD2026_SLED breath led Driver"
	depends on LEDS_CLASS
	help
	  Say Y here to enable breath led.
```
