/*
 * Copyright (c) 2016-2018, The Linux Foundation. All rights reserved.
 *
 * This program is free software; you can redistribute it and/or modify
 * it under the terms of the GNU General Public License version 2 and
 * only version 2 as published by the Free Software Foundation.
 *
 * This program is distributed in the hope that it will be useful,
 * but WITHOUT ANY WARRANTY; without even the implied warranty of
 * MERCHANTABILITY or FITNESS FOR A PARTICULAR PURPOSE.  See the
 * GNU General Public License for more details.
 */

#include "msm8937.dtsi"

&apc_vreg_corner {
	qcom,mem-acc-corner-map = <1 2 2 2 2 2 2>;

	qcom,cpr-fuse-range-list =
		<37 40 3 0>, /* foundry id */
		<36 30 8 0>, /* iddq apc on */
		<67  0 6 0>, /* turbo targ volt */
		<67 18 6 0>; /* nom targ volt */

	qcom,cpr-fuse-range-map =
		<0 0>, < 0   0>, < 0 63>, < 0 40>,
		<0 0>, < 0   0>, < 0 47>, < 0 63>,
		<0 0>, < 1  74>, < 0 63>, < 0 63>,
		<1 1>, < 0   0>, < 0 63>, < 0 41>,
		<1 1>, < 0   0>, < 0 44>, < 0 63>,
		<1 1>, < 1  67>, < 0 63>, < 0 63>;

	qcom,cpr-fuse-range-corner-voltage-adjustment =
		<50000 50000 50000 50000 50000 50000 50000>,
		<50000 50000 50000 50000 50000 50000 50000>,
		<50000 50000 50000 50000 50000 50000 50000>,
		<50000 50000 50000 50000 50000 50000 50000>,
		<50000 50000 50000 50000 50000 50000 50000>,
		<50000 50000 50000 50000 50000 50000 50000>;

	qcom,cpr-fuse-range-corner-quot-adjustment =
		<   95    95    95    95    95    95    95>,
		<   95    95    95    95    95    95    95>,
		<   95    95    95    95    95    95    95>,
		<   95    95    95    95    95    95    95>,
		<   95    95    95    95    95    95    95>,
		<   95    95    95    95    95    95    95>;
};

/* Increase ADSP size by 1M */
&adsp_fw_mem {
	reg = <0x0 0x8d200000 0x0 0x1200000>;
};

&wcnss_fw_mem {
	reg = <0x0 0x8e400000 0x0 0x700000>;
};
