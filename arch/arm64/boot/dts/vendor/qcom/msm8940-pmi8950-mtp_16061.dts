/*
 * Copyright (c) 2016, 2018, The Linux Foundation. All rights reserved.
 *
 * This program is free software; you can redistribute it and/or modify
 * it under the terms of the GNU General Public License version 2 and
 * only version 2 as published by the Free Software Foundation.
 *
 * This program is distributed in the hope that it will be useful,
 * but WITHOUT ANY WARRANTY; without even the implied warranty of
 * MERCHANTABILITY or FITNESS FOR A PARTICULAR PURPOSE.  See the
 * GNU General Public License for more details.
 */

/dts-v1/;

#include "msm8940.dtsi"
#include "msm-camera-clk.dtsi"
#include "msm8940-pmi8950.dtsi"

/*
 * OPPO 平台级覆盖层（顺序有讲究）：
 *   oppo-msm8937/msm8937.dtsi      引入 OPPO 版 regulator/pinctrl/audio/
 *                                  mdss-pll —— 其中 msm8937-regulator.dtsi
 *                                  定义了 touchpanel_vdd，Goodix 触摸屏要用；
 *   oppo-msm8937/msm8940-pmi8950-mtp.dtsi
 *                                  板级（16061）配置，会再叠加 mtp 层。
 * 放在 msm8940*.dtsi 之后，保证覆盖层能盖住平台默认值。
 */
#include "oppo-msm8937/msm8937.dtsi"
#include "oppo-msm8937/msm8940-pmi8950-mtp.dtsi"

/ {
	model = "Qualcomm Technologies, Inc. MSM8940-PMI8950 MTP";
	compatible = "qcom,msm8940-mtp", "qcom,msm8940", "qcom,mtp";
	qcom,board-id = <8 0 16061>;
	qcom,pmic-id = <0x10019 0x020011 0x0 0x0>;
};
